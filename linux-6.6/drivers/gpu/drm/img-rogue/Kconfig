## linux-6.6/drivers/gpu/drm/img-rogue/Kconfig
```kconfig
config POWERVR_ROGUE
	tristate "PowerVR GPU"
	default n
	depends on DRM
	help
	  Driver for PowerVR graphics processor hardware.

	  Say Y here if your SoC contains a PowerVR GPU. For more
	  information, see <http://www.imgtec.com/powervr/>.

config POWERVR_DVFS
	tristate "PowerVR GPU DVFS"
	default n
	depends on POWERVR_ROGUE
	help
	  Driver for Support DVFS in PowerVR GPU.

	  Say Y here if you want to enable DVFS. For more
	  information, see <http://www.imgtec.com/powervr/>.
```
